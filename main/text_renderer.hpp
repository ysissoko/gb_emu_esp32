#pragma once

#include <array>
#include <cstdint>
#include <string>

namespace display::menu {

// Helper to convert RGB565 to BGR565 for ST7789V Seengreat
constexpr uint16_t rgb_to_bgr565(uint16_t rgb) {
    uint16_t r = (rgb >> 11) & 0x1F;  // Extract 5 red bits
    uint16_t g = (rgb >> 5) & 0x3F;   // Extract 6 green bits
    uint16_t b = rgb & 0x1F;          // Extract 5 blue bits
    return (b << 11) | (g << 5) | r;  // Reassemble as BGR
}

// Couleurs RGB565 pour l'écran LCD (converties en BGR pour ST7789V Seengreat)
constexpr uint16_t RGB565_WHITE = rgb_to_bgr565(0xFFFF);
constexpr uint16_t RGB565_BLACK = rgb_to_bgr565(0x0000);
constexpr uint16_t RGB565_LIGHT_GRAY = rgb_to_bgr565(0xC618);
constexpr uint16_t RGB565_DARK_GRAY = rgb_to_bgr565(0x632C);
constexpr uint16_t RGB565_YELLOW = rgb_to_bgr565(0xFFE0);  // Vrai jaune !
constexpr uint16_t RGB565_CYAN = rgb_to_bgr565(0x07FF);
constexpr uint16_t RGB565_GREEN = rgb_to_bgr565(0x07E0);
constexpr uint16_t RGB565_RED = rgb_to_bgr565(0xF800);

// Police 8x8 (réutiliser celle de text_renderer.hpp)
constexpr uint8_t FONT_8X8[][8] = {
    {0x00, 0x00, 0x00, 0x00, 0x00, 0x00, 0x00, 0x00}, // Space (32)
    {0x18, 0x3C, 0x3C, 0x18, 0x18, 0x00, 0x18, 0x00}, // !
    {0x36, 0x36, 0x00, 0x00, 0x00, 0x00, 0x00, 0x00}, // "
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    {0x6E, 0x3B, 0x00, 0x00, 0x00, 0x00, 0x00, 0x00}, // ~
};

// Dessiner un caractère en RGB565
inline void draw_char_rgb565(uint16_t* framebuffer, int fb_width, int fb_height,
                             int x, int y, char c, uint16_t color) {
    if (c < 32 || c > 126) c = 32;

    const uint8_t* glyph = FONT_8X8[c - 32];

    for (int row = 0; row < 8; row++) {
        for (int col = 0; col < 8; col++) {
            if (glyph[row] & (1 << (7 - col))) {
                int px = x + col;
                int py = y + row;
                if (px >= 0 && px < fb_width && py >= 0 && py < fb_height) {
                    framebuffer[py * fb_width + px] = color;
                }
            }
        }
    }
}

// Dessiner du texte en RGB565 (avec protection contre dépassement)
inline void draw_text_rgb565(uint16_t* framebuffer, int fb_width, int fb_height,
                             int x, int y, const std::string& text, uint16_t color) {
    int current_x = x;
    for (char c : text) {
        if (current_x >= fb_width - 8) break; // Stop si hors écran
        if (y + 8 >= fb_height) break;     // Stop si hors écran vertical
        draw_char_rgb565(framebuffer, fb_width, fb_height, current_x, y, c, color);
        current_x += 8;
    }
}

// Effacer le framebuffer RGB565
inline void clear_framebuffer_rgb565(uint16_t* framebuffer, int size, uint16_t color) {
    for (int i = 0; i < size; i++) {
        framebuffer[i] = color;
    }
}

} // namespace display::menu
